## boards/shields/cornedeon_2mod/Kconfig.shield
```kconfig
config SHIELD_CORNEDEON_2MOD_DONGLE
    def_bool $(shields_list_contains,cornedeon_2mod_dongle)

config SHIELD_CORNEDEON_2MOD_LEFT
    def_bool $(shields_list_contains,cornedeon_2mod_left) || $(shields_list_contains,cornedeon_2mod_left_joy)

config SHIELD_CORNEDEON_2MOD_LEFT_CENTRAL
    def_bool $(shields_list_contains,cornedeon_2mod_left_joy_central)

config SHIELD_CORNEDEON_2MOD_RIGHT
    def_bool $(shields_list_contains,cornedeon_2mod_right) || $(shields_list_contains,cornedeon_2mod_right_tps43)

config SHIELD_CORNEDEON_2MOD_RIGHT_CENTRAL
    def_bool $(shields_list_contains,cornedeon_2mod_right_central) || $(shields_list_contains,cornedeon_2mod_right_tps43_central)
```

## config/west.yml
```yaml
manifest:
  remotes:
    - name: zmkfirmware
      url-base: https://github.com/zmkfirmware
    # - name: nxtkb
    #   url-base: https://github.com/nxtkb
    - name: AYM1607
      url-base: https://github.com/AYM1607
    - name: badjeff
      url-base: https://github.com/badjeff
    - name: zettaface
      url-base: https://github.com/zettaface
  projects:
    - name: zmk
      remote: zmkfirmware
      revision: main
      import: app/west.yml
    # - name: cirque-input-module
    #   remote: nxtkb
    #   revision: main
    - name: zmk-driver-azoteq-iqs5xx
      remote: AYM1607
      revision: main
    - name: zmk-analog-input-driver
      remote: badjeff
      revision: main
    - name: zmk-input-processor-keybind
      remote: zettaface
      revision: main
  self:
    path: config
```
