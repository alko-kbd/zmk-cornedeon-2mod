#include "cornedeon_2mod.dtsi"
#include <zephyr/dt-bindings/input/input-event-codes.h>

&kscan0 {
	row-gpios
		= <&pro_micro 18 (GPIO_ACTIVE_HIGH | GPIO_PULL_DOWN)>
		, <&pro_micro 15 (GPIO_ACTIVE_HIGH | GPIO_PULL_DOWN)>
		, <&pro_micro 14 (GPIO_ACTIVE_HIGH | GPIO_PULL_DOWN)>
		, <&pro_micro 16 (GPIO_ACTIVE_HIGH | GPIO_PULL_DOWN)>
		;

	col-gpios
		= <&pro_micro 8 GPIO_ACTIVE_HIGH>
		, <&pro_micro 7 GPIO_ACTIVE_HIGH>
		, <&pro_micro 6 GPIO_ACTIVE_HIGH>
		, <&pro_micro 5 GPIO_ACTIVE_HIGH>
		, <&pro_micro 4 GPIO_ACTIVE_HIGH>
		, <&pro_micro 3 GPIO_ACTIVE_HIGH>
		;
};


&joystick_split {
    status = "disabled";
};

&trackpad_split {
    status = "disabled";
};
