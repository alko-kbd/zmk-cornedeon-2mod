#include "cornedeon_2mod.dtsi"

&default_transform {
    col-offset = <6>;
};

&kscan0 {
    row-gpios
        = <&pro_micro 5 (GPIO_ACTIVE_HIGH | GPIO_PULL_DOWN)>
        , <&pro_micro 6 (GPIO_ACTIVE_HIGH | GPIO_PULL_DOWN)>
        , <&pro_micro 7 (GPIO_ACTIVE_HIGH | GPIO_PULL_DOWN)>
        , <&pro_micro 8 (GPIO_ACTIVE_HIGH | GPIO_PULL_DOWN)>
        , <&pro_micro 9 (GPIO_ACTIVE_HIGH | GPIO_PULL_DOWN)>
        ;

    col-gpios
        = <&pro_micro 14 GPIO_ACTIVE_HIGH>
        , <&pro_micro 15 GPIO_ACTIVE_HIGH>
        , <&pro_micro 18 GPIO_ACTIVE_HIGH>
        , <&pro_micro 19 GPIO_ACTIVE_HIGH>
        , <&pro_micro 20 GPIO_ACTIVE_HIGH>
        , <&pro_micro 21 GPIO_ACTIVE_HIGH>
        ;
};

/* &pro_micro_spi std pins:
   SCK (Clock)     P0.20 (D3)
   MOSI (Data In)  P0.17 (D2)
   MISO (Data Out) P0.22 (D4)
*/

&pro_micro_spi {
    status = "okay";
    cs-gpios = <&pro_micro 10 GPIO_ACTIVE_LOW>;

    glidepoint: glidepoint@0 {
        compatible = "cirque,pinnacle";
        reg = <0>;
        spi-max-frequency = <1000000>;
        status = "okay";
        data-ready-gpios = <&pro_micro 16 (GPIO_ACTIVE_HIGH)>;

        sensitivity = "4x";
        /* sleep; */
        /* no-taps; */
    };
};